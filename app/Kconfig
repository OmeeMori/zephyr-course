## app/Kconfig
```kconfig
menuconfig LED_SUBSYSTEM
    bool "LED Subsystem"
    default y

if LED_SUBSYSTEM

choice
    prompt "LED blink sleep time"
    config BLINK_SPEED_250MS
        bool "fast (250ms)"
    config BLINK_SPEED_1000MS
        bool "1s medium"
    config BLINK_SPEED_2000MS
        bool "slow (2000ms)"
endchoice

config BLINK_SLEEP_TIME_MS
int #
default 250 if BLINK_SPEED_250MS
default 1000 if BLINK_SPEED_1000MS
default 2000 if BLINK_SPEED_2000MS
default 1000

menuconfig ADVANCE_SETTING
bool "Advanced LED settings"
default n

if ADVANCE_SETTING

config LED_BRIGHTNESS
    int "LED brightness (0-100)"
    range 0 100
    default 100

config LED_FADE_DURATION
    int "LED fade duration (ms)"
    default 500

menu "Expert Settings"

    config ENABLE_LED_DEBUGGING
    bool "Enable LED debugging"
    default n
    config CUSTOM_BLINK_PATTERN
    bool "Custom blink pattern"
    default n       
endmenu

endif #ADVANCE_SETTING
endif #LED_SUBSYSTEM

source "Kconfig.zephyr"
```

## app/boards/my_board/board.yml
```yaml
board:
  name: my_board
  full_name: MY Board
  vendor: Zep IOMICO
  socs:
  - name: esp32c3
```

## app/boards/our_board/board.yml
```yaml
board:
  name: our_board
  full_name: OUR Board
  vendor: Zep IOMICO
  socs:
  - name: esp32c3
```
